## firmware/components/mxr_malloc/Kconfig.projbuild
```kconfig
menu "MxR-Malloc"

    # ============================================================
    #  DRAM descriptors
    # ============================================================

    config MXR_MAX_DESC
        int "Maximum simultaneous DRAM allocations"
        range 1 4096
        default 256
        help
            Maximum number of active DRAM allocation descriptors.

            Each DRAM descriptor uses 8 bytes:
                256 descriptors = 2048 bytes
                512 descriptors = 4096 bytes

            This limit is separate from the IRAM descriptor limit.
            If the allocator runs out of DRAM descriptors, further DRAM
            allocations will fail even if free DRAM bytes are still
            available.

            Increase this value if your application keeps many small
            DRAM allocations alive at the same time.

    config MXR_IRAM_MAX_DESC
        int "Maximum simultaneous IRAM allocations"
        depends on MXR_USE_IRAM
        range 1 4096
        default 128
        help
            Maximum number of active IRAM allocation descriptors.

            Each IRAM descriptor uses 8 bytes:
                128 descriptors = 1024 bytes
                256 descriptors = 2048 bytes

            This pool is separate from the DRAM descriptor pool.
            It is used for:
                - MALLOC_CAP_EXEC allocations
                - non-EXEC 32-bit allocations that are placed into IRAM

            If this table becomes full, new IRAM allocations will fail
            even if free IRAM bytes are still available.

    # ============================================================
    #  Descriptor table placement
    # ============================================================

    choice
        prompt "Descriptor table placement"
        depends on MXR_USE_IRAM
        default MXR_DESC_IN_DRAM
        help
            Selects where the allocation descriptor tables are stored.

            Only the descriptor arrays themselves can be moved to IRAM.
            Scalar allocator state is intentionally kept in DRAM because
            ESP8266 IRAM does not support byte/half-word accesses safely.

            DRAM placement is the safest default.
            IRAM placement may reduce DRAM usage, but consumes precious
            IRAM and may not be compatible with all linker scripts.

    config MXR_DESC_IN_DRAM
        bool "DRAM (.bss) - default, safest"
        help
            Keep descriptor tables in normal DRAM (.bss).

            This is the safest and most portable mode.
            It does not require any linker script modification.

            Recommended for most projects.

    config MXR_DESC_IN_IRAM_TEXT
        bool "IRAM (.iram0.text) - no linker patch needed"
        help
            Place descriptor tables into the .iram0.text section.

            This usually works without patching the linker script, but
            it consumes IRAM that would otherwise be available for code.

            Use this only if you need to save DRAM and you understand
            the IRAM usage of your firmware.

    config MXR_DESC_IN_IRAM_BSS
        bool "IRAM (.iram0.bss) - requires patched linker script"
        help
            Place descriptor tables into the .iram0.bss section.

            This is cleaner than .iram0.text for data, but ESP8266
            linker scripts usually do not define .iram0.bss by default.

            Use this only if you have a patched linker script that
            properly defines and reserves the .iram0.bss section.

    endchoice

    # ============================================================
    #  Region configuration
    # ============================================================

    config MXR_REGION_CONFIG
        string "Region boundaries with weights"
        default "4-8%,32-10%,64-10%,128-12%,256-10%,512-20%,1024-0%"
        help
            Configures DRAM size-class regions using a single string.
            Format:
                <min_bytes>-<percent>%,<min_bytes>-<percent>%,...
            Example:
                "4-8%,32-10%,64-10%,128-12%,256-10%,512-20%,1024-0%"
            This creates 7 regions:
                region 0: block size >= 4 bytes    (small structs)
                region 1: block size >= 32 bytes   (i2c_cmd_link_t)
                region 2: block size >= 64 bytes   (spi buf, adc)
                region 3: block size >= 128 bytes  (i2c_cmd_desc_t)
                region 4: block size >= 256 bytes  (medium buffers)
                region 5: block size >= 512 bytes  (DMA buffers)
                region 6: block size >= 1024 bytes (large buffers)

            The min_bytes value is the lower boundary of the region.
            The next region's min_bytes defines the previous region's
            upper boundary. The last region is unlimited and accepts
            all larger blocks.

            The percent value is the memory weight assigned to that
            region during initialization. The sum of all percents must
            be <= 100. Any leftover memory is added to the last region.

            Boundaries are automatically aligned to 4 bytes and must be
            strictly increasing.

            The number of entries determines the number of DRAM regions.
            CMake validates this string during project configuration.

    # ============================================================
    #  Global settings
    # ============================================================

    config MXR_COMPACT_TYPES
        bool "Compact types (uint16 where possible, for ESP8266)"
        default y
        help
            Use compact 16-bit types where possible for ESP8266.

            On ESP8266 this is normally correct because:
                - heap arena is <= 128 KB
                - size-class boundaries are usually <= 64 KB
                - allocation counters are small

            Enabling this reduces RAM usage of region/state structures.

            Disable this only if you need size-class boundaries above
            64 KB or if you are adapting MxR-malloc to another target.

    config MXR_IRAM_HOT_PATH_DISABLED
        bool "Disable placing malloc/free hot path in IRAM"
        default n
        help
            By default, MxR-malloc places the core malloc/free hot path
            into IRAM.

            Enable this option if IRAM is too small and you need to save
            IRAM space.

            Warning:
            If malloc/free are called while flash cache is disabled,
            for example from some flash-write/erase related paths,
            flash-resident code may crash. Keep the hot path in IRAM
            unless you know this is safe for your project.

    choice
        prompt "IRAM hot path scope"
        depends on !MXR_IRAM_HOT_PATH_DISABLED
        default MXR_IRAM_PATH_CORE
        help
            Selects which allocator functions are placed into IRAM.

            Core:
                Only malloc/free hot path is placed in IRAM.
                This uses the least IRAM.

            Allocation family:
                malloc/free/calloc/zalloc/realloc are placed in IRAM.
                This uses significantly more IRAM, especially because
                realloc is large.

            Use Allocation family only if these functions may be called
            in contexts where flash cache is disabled.

    config MXR_IRAM_PATH_CORE
        bool "Core (malloc/free only)"
        help
            Place only the core malloc/free path into IRAM.

            This is the recommended default because it gives the most
            important ISR-safe behavior while consuming the least IRAM.

    config MXR_IRAM_PATH_ALLOC_FAMILY
        bool "Allocation family (malloc/free/calloc/zalloc/realloc)"
        help
            Place the full allocation family into IRAM:
                malloc
                free
                calloc
                zalloc
                realloc

            This increases IRAM usage noticeably.
            Check idf.py size output before using this option.

    endchoice

    # ============================================================
    #  IRAM heap
    # ============================================================

    config MXR_USE_IRAM
        bool "Enable IRAM heap (EXEC + 32BIT fallback)"
        default y if !CONFIG_HEAP_DISABLE_IRAM
        default n
        help
            Enables the IRAM heap arena.

            When enabled:
                - MALLOC_CAP_EXEC allocations are served from IRAM
                - pure 32-bit allocations may also use IRAM if allowed
                  by reserve and size-limit settings
                - allocations requiring MALLOC_CAP_8BIT, MALLOC_CAP_DMA
                  or MALLOC_CAP_SPIRAM are never placed into IRAM

            Disable this if you want all normal allocations to stay in
            DRAM only.

    config MXR_IRAM_RESERVE_BYTES
        int "Reserve IRAM bytes for EXEC allocations"
        depends on MXR_USE_IRAM
        range 0 32768
        default 2048
        help
            Defines the EXEC zone [0, reserve) at the start of IRAM.

            HARD binding rules:
              - MALLOC_CAP_EXEC allocations are placed ONLY inside
                [0, reserve). They can never cross this boundary,
                neither on malloc nor on realloc grow.
              - Non-EXEC 32-bit fallback allocations can never enter
                this zone (as before).
              - Setting this to 0 completely disables EXEC
                allocations: every MALLOC_CAP_EXEC request returns
                NULL and increments exec_zone_rejects.

            Recommended default: 2048.
    
    config MXR_IRAM_FALLBACK_ENABLED
        bool "Enable 32BIT fallback into IRAM (non-EXEC)"
        depends on MXR_USE_IRAM
        default y
        help
            If enabled, pure 32-bit allocations such as malloc(),
            _malloc_r(), heap_caps_malloc(size, MALLOC_CAP_32BIT),
            heap_caps_malloc(size, MALLOC_CAP_INTERNAL) and
            heap_caps_malloc(size, 0) may be placed into the
            IRAM fallback zone.

            If disabled, MALLOC_CAP_EXEC allocations still use the
            EXEC zone, but all non-EXEC 32-bit allocations are forced
            to DRAM.

            Disable this if you do not need IRAM for data and want to
            avoid the risk of byte/half-word accesses to IRAM memory.

    config MXR_IRAM_FALLBACK_MAX_BYTES
        int "Maximum block size for IRAM fallback"
        depends on MXR_USE_IRAM && MXR_IRAM_FALLBACK_ENABLED
        range 0 65536
        default 0
        help
            Maximum size of a non-EXEC block that is allowed to be
            placed into IRAM.

            Set this to prevent large non-executable buffers from
            consuming IRAM.

            Use 0 for no limit.

            EXEC allocations are not limited by this option.

    config MXR_IRAM_EXEC_WHOLE_IF_NO_FB
        bool "Give whole IRAM to EXEC zone when fallback is disabled"
        depends on MXR_USE_IRAM && !MXR_IRAM_FALLBACK_ENABLED
        default y
        help
            When 32BIT fallback is disabled, the IRAM area beyond
            CONFIG_MXR_IRAM_RESERVE_BYTES would otherwise be unusable
            but still counted in heap statistics (overreported free
            memory).
            If enabled (recommended), the EXEC zone is expanded to
            cover the whole IRAM arena, so MALLOC_CAP_EXEC allocations
            can use all IRAM.
            If disabled, the EXEC zone stays [0, reserve) and the rest
            of IRAM is excluded from the arena and from all statistics.

    choice
        prompt "IRAM fallback allocation order"
        depends on MXR_USE_IRAM && MXR_IRAM_FALLBACK_ENABLED
        default MXR_IRAM_FB_ORDER_DRAM_FIRST
        help
            IRAM first:
                Pure 32-bit allocations try the IRAM fallback zone
                BEFORE DRAM (original MxR behavior).
            DRAM first (recommended):
                Pure 32-bit allocations try DRAM first and only use
                the IRAM fallback zone when DRAM allocation fails.
                This keeps arbitrary byte-accessed data out of IRAM
                as long as DRAM has room.

    config MXR_IRAM_FB_ORDER_IRAM_FIRST
        bool "IRAM first (original MxR behavior)"
        help
            32-bit allocations prefer the IRAM fallback zone.

    config MXR_IRAM_FB_ORDER_DRAM_FIRST
        bool "DRAM first, IRAM as true fallback (recommended)"
        help
            32-bit allocations use IRAM only after DRAM fails.

    endchoice
    
    # ============================================================
    #  IRAM fallback region configuration
    # ============================================================
    config MXR_IRAM_FALLBACK_REGION_CONFIG
        string "IRAM fallback region layout"
        depends on MXR_USE_IRAM && MXR_IRAM_FALLBACK_ENABLED
        default "4-8%,32-10%,64-10%,128-12%,256-10%,512-20%,1024-0%"
        help
            Configures size-class regions inside the IRAM fallback zone.
            The fallback zone is the IRAM area NOT reserved for EXEC:
                [CONFIG_MXR_IRAM_RESERVE_BYTES, iram_end)

            Format is identical to CONFIG_MXR_REGION_CONFIG:
                <min_bytes>-<percent>%,<min_bytes>-<percent>%,...

            Empty string (default) means a single flat fallback region
            covering the whole fallback zone (original behavior).

            Examples:
                ""                    -> single flat fallback region
                "4-40%,128-0%"        -> blocks >=4 get 40% of the zone,
                                         blocks >=128 get the rest
                "4-30%,256-30%,1024-0%"

            EXEC allocations are NOT affected by this setting.
            They always use the EXEC zone [0, reserve) protected by
            CONFIG_MXR_IRAM_RESERVE_BYTES.

            The number of entries determines the number of IRAM
            fallback regions. CMake validates this string during
            project configuration.

    # ============================================================
    #  Cross-region fallback (DRAM + IRAM)
    # ============================================================
    config MXR_CROSS_REGION_FALLBACK
        bool "Enable cross-region fallback (master switch)"
        default y
        help
            Master switch for the cross-region fallback mechanism.
            When enabled, a block that cannot be allocated in its own
            size-class region may be placed into another region as a
            last resort - subject to the per-arena enable switches and
            guard settings below.
            DRAM and IRAM are controlled independently:
              - CONFIG_MXR_DRAM_CROSS_ENABLED
              - CONFIG_MXR_IRAM_CROSS_ENABLED

    # ------------------------------------------------------------
    #  DRAM cross-region
    # ------------------------------------------------------------
    config MXR_DRAM_CROSS_ENABLED
        bool "Enabled - use cross-region fallback for DRAM"
        depends on MXR_CROSS_REGION_FALLBACK
        default y
        help
            Enables DRAM cross-region fallback.
            Allocations that cannot fit in their own DRAM size-class
            region will try other DRAM regions as a last resort,
            subject to the guard settings below.
            If disabled, allocations that do not fit in their own DRAM
            region fail with alloc_fail_no_memory.
            IRAM cross-region is controlled separately by
            CONFIG_MXR_IRAM_CROSS_ENABLED.

    choice
        prompt "DRAM cross-region max_bytes guard aggressiveness"
        depends on MXR_CROSS_REGION_FALLBACK
        depends on MXR_DRAM_CROSS_ENABLED
        default MXR_DRAM_CROSS_MODERATE
        help
            Controls the max_bytes GUARD applied during DRAM
            cross-region fallback. The GUARD protects a target region
            from blocks that are too large for its size class.

            Conservative: reject blocks > 50% of target max_bytes.
                Best region isolation, more allocation failures.
            Moderate (recommended): reject blocks > 75%.
                Balanced between isolation and success rate.
            Aggressive: reject blocks > 90%.
                Fewer allocation failures, more fragmentation.
            All: no max_bytes check at all.
                Any block can go into any DRAM region.

    config MXR_DRAM_CROSS_CONSERVATIVE
        bool "Conservative - strict DRAM region isolation (50%)"
        help
            Use cross-region only as an absolute last resort.
            Small DRAM regions are strongly protected from large blocks.
            Use this if your workload is stable and predictable.

    config MXR_DRAM_CROSS_MODERATE
        bool "Moderate - balanced (recommended, 75%)"
        help
            Balanced between DRAM region isolation and allocation success.
            This is the recommended default for most workloads.

    config MXR_DRAM_CROSS_AGGRESSIVE
        bool "Aggressive - prefer allocation success (90%)"
        help
            Cross-region is used more eagerly to avoid allocation
            failures. DRAM region boundaries are weakly enforced.

    config MXR_DRAM_CROSS_ALL
        bool "All - no max_bytes guard"
        help
            No GUARD is applied: a cross-region block may occupy any
            DRAM region regardless of its max_bytes. Maximizes the
            allocation success rate, provides no region protection.
            Note: large blocks may then consume small-class regions.

    endchoice

    choice
        prompt "DRAM cross-region min_bytes guard aggressiveness"
        depends on MXR_CROSS_REGION_FALLBACK
        depends on MXR_DRAM_CROSS_ENABLED
        default MXR_DRAM_CROSS_MIN_BYTES_MODERATE
        help
            Controls the min_bytes guard during DRAM cross-region.
            This guard protects large-block DRAM regions from being
            fragmented by tiny allocations.

            The check is:
                if (bytes * DIVISOR < region.min_bytes) -> skip region

            Conservative (DIVISOR=1): block must be >= region.min_bytes.
            Moderate (DIVISOR=2, recommended): >= region.min_bytes / 2.
            Aggressive (DIVISOR=4): >= region.min_bytes / 4.
            All: no min_bytes check at all.

    config MXR_DRAM_CROSS_MIN_BYTES_CONSERVATIVE
        bool "Conservative - strict min_bytes check (divisor 1)"
        help
            Block must be >= DRAM region.min_bytes.
            Strictest protection of large-block DRAM regions.

    config MXR_DRAM_CROSS_MIN_BYTES_MODERATE
        bool "Moderate - min_bytes / 2 (recommended, divisor 2)"
        help
            Block must be >= DRAM region.min_bytes / 2.
            Recommended balance between isolation and success.

    config MXR_DRAM_CROSS_MIN_BYTES_AGGRESSIVE
        bool "Aggressive - min_bytes / 4 (divisor 4)"
        help
            Block must be >= DRAM region.min_bytes / 4.
            Allows more cross-region placements in DRAM.

    config MXR_DRAM_CROSS_MIN_BYTES_ALL
        bool "All - no min_bytes check"
        help
            Completely disable the min_bytes guard for DRAM.
            Any block can be placed in any DRAM region.

    endchoice

    # ------------------------------------------------------------
    #  IRAM fallback cross-region
    # ------------------------------------------------------------
    config MXR_IRAM_CROSS_ENABLED
        bool "Enabled - use cross-region fallback for IRAM"
        depends on MXR_CROSS_REGION_FALLBACK
        depends on MXR_USE_IRAM
        depends on MXR_IRAM_FALLBACK_ENABLED
        default y
        help
            Enables cross-region fallback inside the IRAM fallback zone.
            Non-EXEC 32-bit allocations that cannot fit in their own
            IRAM fb region will try other IRAM fb regions as a last
            resort, subject to the guard settings below.
            If disabled, such allocations fall through to DRAM instead
            of trying other IRAM fb regions.
            DRAM cross-region is controlled separately by
            CONFIG_MXR_DRAM_CROSS_ENABLED.

    choice
        prompt "IRAM fallback cross-region max_bytes guard aggressiveness"
        depends on MXR_CROSS_REGION_FALLBACK
        depends on MXR_IRAM_CROSS_ENABLED
        depends on MXR_USE_IRAM
        default MXR_IRAM_CROSS_CONSERVATIVE
        help
            Controls the max_bytes GUARD inside the IRAM fallback zone.
            IRAM is a scarce resource that competes with EXEC
            allocations, so the recommended default is more
            conservative than for DRAM.

            Conservative (recommended): reject blocks > 50% of max_bytes.
            Moderate: reject blocks > 75%.
            Aggressive: reject blocks > 90%.
            All: no max_bytes check at all.

    config MXR_IRAM_CROSS_CONSERVATIVE
        bool "Conservative - strict IRAM region isolation (recommended, 50%)"
        help
            Use IRAM cross-region only as an absolute last resort.
            Protects the limited IRAM fallback zone from fragmentation.

    config MXR_IRAM_CROSS_MODERATE
        bool "Moderate - balanced (75%)"
        help
            Balanced between IRAM region isolation and allocation success.

    config MXR_IRAM_CROSS_AGGRESSIVE
        bool "Aggressive - prefer allocation success (90%)"
        help
            IRAM cross-region is used more eagerly.
            May fragment the limited IRAM fallback zone.

    config MXR_IRAM_CROSS_ALL
        bool "All - no max_bytes guard"
        help
            No GUARD is applied inside the IRAM fallback zone.
            Any block can go into any IRAM fb region.

    endchoice

    choice
        prompt "IRAM fallback cross-region min_bytes guard aggressiveness"
        depends on MXR_CROSS_REGION_FALLBACK
        depends on MXR_IRAM_CROSS_ENABLED
        depends on MXR_USE_IRAM
        default MXR_IRAM_CROSS_MIN_BYTES_MODERATE
        help
            Controls the min_bytes guard inside the IRAM fallback zone.
            The check is:
                if (bytes * DIVISOR < region.min_bytes) -> skip region

            Conservative (DIVISOR=1): block must be >= region.min_bytes.
            Moderate (DIVISOR=2, recommended): >= region.min_bytes / 2.
            Aggressive (DIVISOR=4): >= region.min_bytes / 4.
            All: no min_bytes check at all.

    config MXR_IRAM_CROSS_MIN_BYTES_CONSERVATIVE
        bool "Conservative - strict min_bytes check (divisor 1)"

    config MXR_IRAM_CROSS_MIN_BYTES_MODERATE
        bool "Moderate - min_bytes / 2 (recommended, divisor 2)"

    config MXR_IRAM_CROSS_MIN_BYTES_AGGRESSIVE
        bool "Aggressive - min_bytes / 4 (divisor 4)"

    config MXR_IRAM_CROSS_MIN_BYTES_ALL
        bool "All - no min_bytes check"

    endchoice


    config MXR_ANTI_SLIVER
        bool "Enable anti-sliver expansion (consume tiny leftover gaps)"
        default y
        help
            When a block is cut from a gap and the leftover tail would be
            smaller than MXR_MIN_SLICE_BYTES, the block is expanded to
            consume the entire gap. Also prevents realloc shrink from
            creating tiny tails.
            Disabling removes all block expansions: every allocation gets
            exactly the requested (4-aligned) size and every realloc shrink
            splits the block.
            Disable only for experiments/benchmarking: it increases the
            number of unusable micro-gaps (slivers) and makes future
            searches slower.


    config MXR_MIN_SLICE_BYTES
        int "Minimum useful gap size (anti-sliver threshold)"
        depends on MXR_ANTI_SLIVER
        range 4 64
        default 8
        help
            If the remainder after cutting a block from a gap is smaller
            than this value, the block is expanded to consume the entire
            gap. This prevents creation of unusable micro-fragments.
            Also applies to realloc shrink: if the tail would be smaller
            than this, the block is not split.
            Recommended: 8 bytes (2 alignment units).

    config MXR_BEST_FIT_EARLY_EXIT
        bool "Enable best-fit early-exit (stop on a good-enough gap)"
        default y
        help
            When enabled, the free-gap search stops as soon as a gap with
            waste <= requested_size >> MXR_BEST_FIT_WASTE_SHIFT is found.
            When disabled, the allocator performs a strict best-fit scan
            of the whole region: only an exact-fit gap (waste == 0) stops
            the search early.
            Disabling reduces fragmentation but makes every allocation do
            a full descriptor scan with interrupts disabled. Use only if
            fragmentation matters more than worst-case allocation latency.


    config MXR_BEST_FIT_WASTE_SHIFT
        int "Best-fit early-exit waste threshold (shift)"
        depends on MXR_BEST_FIT_EARLY_EXIT
        range 1 4
        default 2
        help
            Controls the best-fit early-exit threshold.
            If (gap - requested_size) <= requested_size >> SHIFT,
            the gap is considered "good enough" and the search stops.
            SHIFT=1: 50% waste tolerance (faster, more fragmentation)
            SHIFT=2: 25% waste tolerance (balanced, recommended)
            SHIFT=3: 12.5% waste tolerance (tighter, slower)
            SHIFT=4: 6.25% waste tolerance (near-exact best-fit)

    # ============================================================
    #  Integration mode
    # ============================================================

    choice
        prompt "Integration mode"
        default MXR_INTEGRATION_WRAP
        help
            Selects how MxR-malloc is integrated into the ESP8266
            RTOS SDK build.

            Wrap mode:
                Safest and recommended.
                The original heap component remains in the build, but
                linker --wrap redirects heap_caps_* calls to MxR.

            Compat mode:
                MxR directly provides heap_caps_* API.
                The original heap component must be excluded from the
                build, otherwise duplicate symbols will appear.

            Port mode:
                MxR provides both heap_caps_* and standard libc-style
                malloc/free/calloc/realloc/zalloc symbols.
                Also requires excluding conflicting original sources.

    config MXR_INTEGRATION_WRAP
        bool "Wrap mode (linker --wrap, default & safest)"
        help
            Use linker --wrap to redirect original heap API calls to
            MxR-malloc.

            This is the safest integration mode:
                - original heap component can stay in the build
                - easy to enable/disable
                - no manual source exclusion required in most projects

            Recommended default.

    config MXR_INTEGRATION_COMPAT
        bool "Compat mode (replaces original heap_caps_* API)"
        help
            Compile MxR as a direct replacement for the original
            heap_caps_* implementation.

            Important:
            You must exclude the original heap component or its
            conflicting source files from the build. Otherwise the
            linker will report duplicate symbols.

    config MXR_INTEGRATION_PORT
        bool "Port mode (replaces standard libc malloc/free)"
        help
            Compile MxR as a replacement for both heap_caps_* and
            standard libc-style allocation functions:
                malloc
                free
                calloc
                realloc
                zalloc

            This mode is more intrusive.
            You must make sure original implementations of these
            functions are not linked into the firmware.

    endchoice

    # ============================================================
    #  Linker integration (Wrap mode only)
    # ============================================================

    menu "Linker integration (Wrap mode only)"
        depends on MXR_INTEGRATION_WRAP

        config MXR_WRAP_HEAP_QUERY
            bool "Wrap heap_caps_get_free_size / minimum / dram"
            default y
            help
                Wrap heap query functions:
                    heap_caps_get_free_size
                    heap_caps_get_minimum_free_size
                    heap_caps_get_dram_free_size

                Keep this enabled if you want heap statistics reported
                by MxR-malloc instead of the original heap code.

                If disabled, query functions may return incorrect values
                because the original heap may not be initialized when
                MxR replaces heap_caps_init().

        config MXR_WRAP_DEFAULT_POOL
            bool "Wrap heap_caps_malloc_default / realloc_default"
            default y
            help
                Wrap:
                    heap_caps_malloc_default
                    heap_caps_realloc_default

                These functions are used by some SDK components.
                Keep this enabled for consistent default-pool behavior
                through MxR-malloc.

        config MXR_WRAP_ESP_SYSTEM
            bool "Wrap esp_get_free_heap_size / minimum / internal"
            default y
            help
                Wrap system heap query functions:
                    esp_get_free_heap_size
                    esp_get_minimum_free_heap_size
                    esp_get_free_internal_heap_size

                Keep this enabled if you want correct free-heap values
                in application code and logs.

        config MXR_WRAP_LIBC
            bool "Wrap plain malloc / free / calloc / realloc / zalloc"
            default y
            help
                Wrap plain libc-style allocation functions:
                    malloc
                    free
                    calloc
                    realloc
                    zalloc

                This can intercept more allocations, but may conflict
                with newlib/port layer implementations depending on SDK
                configuration.

                Enable only if you specifically need this behavior.

        config MXR_WARN_HEAP_TRACING
            bool "Warn if CONFIG_HEAP_TRACING is enabled"
            default y
            help
                Warn at CMake configure time if CONFIG_HEAP_TRACING is
                enabled together with MxR wrap mode.

                Original heap tracing is not compatible with MxR wrap
                mode because the original allocator is bypassed.

                Keep this warning enabled.

    endmenu

    # ============================================================
    #  Diagnostics
    # ============================================================

    choice
        prompt "Diagnostics output level"
        default MXR_DUMP_NORMAL
        help
            Controls how much information is printed by mxr_dump().

            Minimal:
                Very short summary.
                Suitable for periodic logging.

            Normal:
                Summary plus region state, descriptor usage and error
                counters.
                Recommended for normal debugging.

            Full:
                Everything from Normal plus all active descriptors.
                Output can be very large.
                Use only for deep heap debugging.

    config MXR_DUMP_MINIMAL
        bool "Minimal - totals only"
        help
            Print only the most important totals:
                total bytes
                free bytes
                minimum free bytes
                largest free block

            Best for periodic runtime logging.

    config MXR_DUMP_NORMAL
        bool "Normal - totals, regions and counters"
        help
            Print totals, region information, descriptor usage,
            IRAM information and allocation failure counters.

            Recommended default for debugging.

    config MXR_DUMP_FULL
        bool "Full - normal plus all descriptors"
        help
            Print everything from Normal mode and also dump every
            active allocation descriptor.

            This may print hundreds of lines if many allocations are
            active. Use only for deep heap analysis.

    endchoice

endmenu
```
